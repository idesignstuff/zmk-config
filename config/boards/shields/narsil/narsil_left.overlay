/*
 * Copyright (c) 2021 The ZMK Contributors
 *
 * SPDX-License-Identifier: MIT
 */

#include "narsil.dtsi"





&kscan0 {
	col-gpios 
		= 	  <&gpio0 2   (GPIO_ACTIVE_HIGH | GPIO_PULL_DOWN)>
        	, <&gpio0 3   (GPIO_ACTIVE_HIGH | GPIO_PULL_DOWN)>
        	, <&gpio0 28  (GPIO_ACTIVE_HIGH | GPIO_PULL_DOWN)>
        	, <&gpio0 29  (GPIO_ACTIVE_HIGH | GPIO_PULL_DOWN)>
        	, <&gpio1 15  (GPIO_ACTIVE_HIGH | GPIO_PULL_DOWN)>
        	;
};

&left_encoder {
    status = "okay";
};
