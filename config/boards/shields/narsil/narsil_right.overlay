/*
 * Copyright (c) 2021 The ZMK Contributors
 *
 * SPDX-License-Identifier: MIT
 */

#include "narsil.dtsi"

&default_transform {
	col-offset = <5>;
};

&kscan0 {
	col-gpios
		= <&gpio1 15  (GPIO_ACTIVE_HIGH | GPIO_PULL_DOWN)>
        	, <&gpio0 29  (GPIO_ACTIVE_HIGH | GPIO_PULL_DOWN)>
        	, <&gpio0 28  (GPIO_ACTIVE_HIGH | GPIO_PULL_DOWN)>
        	, <&gpio0 3   (GPIO_ACTIVE_HIGH | GPIO_PULL_DOWN)>
		, <&gpio0 2   (GPIO_ACTIVE_HIGH | GPIO_PULL_DOWN)>
        	;
};
&right_encoder {
    status = "okay";
};
