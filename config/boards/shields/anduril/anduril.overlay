/*
 * Copyright (c) 2024 The ZMK Contributors
 *
 * SPDX-License-Identifier: MIT
 */
 
#include "layouts/anduril.dtsi"

/ {
	anduril_layout: layout {
		compatible = "zmk,physical-layout";
		display-name = "Anduril";
		layout = <
			&layout_5x10
		>;
	};
};
