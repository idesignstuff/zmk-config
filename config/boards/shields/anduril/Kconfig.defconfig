## config/boards/shields/anduril/Kconfig.defconfig
```kconfig
# Copyright (c) 2024 The ZMK Contributors
# SPDX-License-Identifier: MIT
if SHIELD_ANDURIL

config ZMK_KEYBOARD_NAME
    default "anduril"

endif
```

## config/boards/shields/anduril/kconfig.defconfig
```kconfig
# Copyright (c) 2024 The ZMK Contributors
# SPDX-License-Identifier: MIT

config ZMK_KEYBOARD_NAME
	default "anduril"

config SHIELD_ANDURIL
    def_bool $(shields_list_contains,anduril)
```

## config/boards/shields/klein/Kconfig.defconfig
```kconfig
if SHIELD_KLEIN_LEFT

config ZMK_KEYBOARD_NAME
    default "klein"

config ZMK_SPLIT_BLE_ROLE_CENTRAL
    	default y

endif

if SHIELD_KLEIN_LEFT || SHIELD_KLEIN_RIGHT

config ZMK_SPLIT
    default y

endif
if ZMK_DISPLAY

config I2C
	default y

config SSD1306
	default y

LV_DPI_DEF

endif # ZMK_DISPLAY


if ZMK_BACKLIGHT

config PWM
    default y

config LED_PWM
    default y

endif # ZMK_BACKLIGHT
```

## config/boards/shields/klein/Kconfig.shield
```kconfig
config SHIELD_KLEIN_LEFT
    def_bool $(shields_list_contains,klein_left)
    select NFCT_PINS_AS_GPIOS
config SHIELD_KLEIN_RIGHT
    def_bool $(shields_list_contains,klein_right)  
    select NFCT_PINS_AS_GPIOS
config SHIELD_VIK_SSD1306_128X64
	def_bool $(shields_list_contains,vik_ssd1306_128x64)
	imply ZMK_DISPLAY
```

## config/boards/shields/narsil/Kconfig.defconfig
```kconfig
# Copyright (c) 2021 The ZMK Contributors
# SPDX-License-Identifier: MIT

# uncomment to allow Windows to update battery level after pairing
CONFIG_BT_GATT_ENFORCE_SUBSCRIPTION=n

if SHIELD_NARSIL_LEFT

config ZMK_KEYBOARD_NAME
	default "narsil"

config ZMK_SPLIT_ROLE_CENTRAL
	default y

endif

if SHIELD_NARSIL_LEFT || SHIELD_NARSIL_RIGHT

config ZMK_SPLIT
	default y

endif
```

## config/boards/shields/narsil/Kconfig.shield
```kconfig
config SHIELD_NARSIL_LEFT
    def_bool $(shields_list_contains,narsil_left)

config SHIELD_NARSIL_RIGHT
    def_bool $(shields_list_contains,narsil_right)  
```

## config/boards/shields/void9/kconfig.defconfig
```kconfig
# Copyright (c) 2021 The ZMK Contributors
# SPDX-License-Identifier: MIT

# uncomment to allow Windows to update battery level after pairing
# CONFIG_BT_GATT_ENFORCE_SUBSCRIPTION=n

# uncomment to stop ring buffer full warning in log
CONFIG_USB_CDC_ACM_LOG_LEVEL_WRN=y

if SHIELD_MY_BOARD

config ZMK_KEYBOARD_NAME
    default "void9"

endif
```

## config/west.yml
```yaml
manifest:
  remotes:
    - name: zmkfirmware
      url-base: https://github.com/zmkfirmware
    - name: petejohanson
      url-base: https://github.com/petejohanson
    # - name: nickconway
    #   url-base: https://github.com/nickconway
  projects:
    - name: zmk
      # remote: zmkfirmware
      # revision: main
      remote: petejohanson
      revision: stephen/split-encoder
      import: app/west.yml
      # remote: nickconway
      # revision: dynamic-macro
      # import: app/west.yml
  self:
    path: config
    
```
